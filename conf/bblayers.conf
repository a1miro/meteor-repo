## conf/bblayers.conf
```bitbake
# POKY_BBLAYERS_CONF_VERSION is increased each time build/conf/bblayers.conf
# changes incompatibly
POKY_BBLAYERS_CONF_VERSION = "2"

BBPATH = "${TOPDIR}"
BBFILES ?= ""

BBLAYERS ?= " \
  /build/build/poky-jetson-dev/sources/poky/meta \
  /build/build/poky-jetson-dev/sources/poky/meta-poky \
  /build/build/poky-jetson-dev/sources/poky/meta-yocto-bsp \
  /build/build/poky-jetson-dev/sources/meta-tegra \
  "
```
